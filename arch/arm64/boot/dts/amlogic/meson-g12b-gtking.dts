// SPDX-License-Identifier: (GPL-2.0+ OR MIT)
/*
 * Copyright (c) 2019 BayLibre, SAS
 * Author: Neil Armstrong <narmstrong@baylibre.com>
 * Copyright (c) 2019 Christian Hewitt <christianshewitt@gmail.com>
 */

/dts-v1/;

#include "meson-g12b-w400.dtsi"
#include "meson-g12-audio-hdmi-spdif.dtsi"

/ {
	compatible = "azw,gtking", "amlogic,g12b";
	model = "Beelink GT-King";
};
