// SPDX-License-Identifier: (GPL-2.0+ OR MIT)
/*
 * Copyright (c) 2019 BayLibre, SAS
 * Author: Neil Armstrong <narmstrong@baylibre.com>
 * Copyright (c) 2019 Christian Hewitt <christianshewitt@gmail.com>
 */

/dts-v1/;

#include "meson-g12b-w400.dtsi"
#include "meson-g12-audio-hdmi-spdif.dtsi"

/ {
	compatible = "ugoos,am6", "amlogic,s922x", "amlogic,g12b";
	model = "Ugoos AM6";
};

&ir {
	linux,rc-map-name = "rc-khadas";
};
